#include <behaviors.dtsi>
#include <dt-bindings/zmk/bt.h>
#include <dt-bindings/zmk/keys.h>

/ {
    keymap {
        compatible = "zmk,keymap";

        Base_layer {
            label = "BASE";
            bindings = <
&kp KP_NUM  &kp FSLH  &kp ASTRK  &kp MINUS  &kp KP_NUMBER_7  &kp KP_NUMBER_8  &kp KP_NUMBER_9  &kp PLUS  &kp KP_NUMBER_4  &kp KP_NUMBER_5  &kp KP_N6  &kp KP_NUMBER_1  &kp KP_N2  &kp KP_NUMBER_3  &kp KP_ENTER  &kp KP_NUMBER_0  &kp KP_DOT
            >;
        };

        Number_layer {
            bindings = <
&trans  &bt BT_PRV  &bt BT_NXT  &kp BACKSPACE  &bt BT_PRV  &bt BT_NXT  &trans  &trans  &bt BT_SEL 3  &bt BT_SEL 4  &trans  &bt BT_SEL 0  &bt BT_SEL 1  &bt BT_SEL 2  &trans  &bootloader  &bt BT_CLR
            >;

            label = "NUMBER";
        };
    };
};
